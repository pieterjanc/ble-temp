## CMakeLists.txt
```
cmake_minimum_required(VERSION 3.13.1)
find_package(Zephyr REQUIRED HINTS $ENV{ZEPHYR_BASE})
project(ble-temp)

target_sources(app PRIVATE
	src/ble-env.c
	src/main.c
	src/sht21.c
	)
```

## prj.conf
```kconfig
# bluetooth
CONFIG_BT=y
CONFIG_BT_DEBUG_LOG=y
CONFIG_BT_PERIPHERAL=y
CONFIG_BT_DEVICE_NAME="ble-temp"

# sensor
CONFIG_I2C=y
```

## src/main.c
```c
#include <bluetooth/bluetooth.h>
#include <bluetooth/uuid.h>
#include <logging/log.h>
#include <zephyr.h>

#include "ble-env.h"
#include "sht21.h"

LOG_MODULE_REGISTER(main, LOG_LEVEL_DBG);

static const struct bt_data adv[] = {
        BT_DATA_BYTES(BT_DATA_FLAGS, (BT_LE_AD_GENERAL | BT_LE_AD_NO_BREDR)),
        BT_DATA_BYTES(BT_DATA_UUID16_ALL, BT_UUID_16_ENCODE(BT_UUID_ESS_VAL)),
};

static int measure()
{
    int err;
    int16_t temp;
    uint16_t hum;

    err = sht21_temperature(&temp);
    if (err)
    {
        return err;
    }
    ble_env_update_temperature(temp);

    err = sht21_humidity(&hum);
    if (err)
    {
        return err;
    }
    ble_env_update_humidity(hum);

    return 0;
}

void main(void)
{
    int err;

    err = bt_enable(NULL);
    if (err)
    {
        LOG_ERR("Bluetooth init failed (err %d)\n", err);
        return;
    }

    err = bt_le_adv_start(BT_LE_ADV_CONN_NAME, adv, ARRAY_SIZE(adv), NULL, 0);
    if (err)
    {
        LOG_ERR("Advertising failed to start (err %d)\n", err);
        return;
    }

    sht21_reset();

    while (true)
    {
        measure();
        k_sleep(K_MINUTES(1));
    }
}
```

## src/ble-env.c
```c
#include <sys/byteorder.h>

#include <bluetooth/gatt.h>

#include "ble-env.h"

struct env_data_t
{
    int16_t temp_value;
    uint16_t hum_value;
};

static struct env_data_t env_data = {
        .temp_value = 0,
        .hum_value = 0,
};

static ssize_t read_u16(struct bt_conn *conn, const struct bt_gatt_attr *attr, void *buf, uint16_t len, uint16_t offset)
{
    const uint16_t *u16 = attr->user_data;
    uint16_t value = sys_cpu_to_le16(*u16);

    return bt_gatt_attr_read(conn, attr, buf, len, offset, &value, sizeof(value));
}

BT_GATT_SERVICE_DEFINE(ess_service,
                       BT_GATT_PRIMARY_SERVICE(BT_UUID_ESS),
                       BT_GATT_CHARACTERISTIC(BT_UUID_TEMPERATURE,
                                              BT_GATT_CHRC_READ | BT_GATT_CHRC_NOTIFY,
                                              BT_GATT_PERM_READ,
                                              read_u16, NULL, &env_data.temp_value),
                       BT_GATT_CCC(NULL,
                                   BT_GATT_PERM_READ | BT_GATT_PERM_WRITE),
                       BT_GATT_CHARACTERISTIC(BT_UUID_HUMIDITY,
                                              BT_GATT_CHRC_READ | BT_GATT_CHRC_NOTIFY,
                                              BT_GATT_PERM_READ,
                                              read_u16, NULL, &env_data.hum_value),
                       BT_GATT_CCC(NULL,
                                   BT_GATT_PERM_READ | BT_GATT_PERM_WRITE), );

void ble_env_update_temperature(int16_t temp)
{
    if (temp != env_data.temp_value)
    {
        env_data.temp_value = temp;
        bt_gatt_notify(NULL, &ess_service.attrs[2], &temp, sizeof(temp));
    }
}

void ble_env_update_humidity(uint16_t hum)
{
    if (hum != env_data.hum_value)
    {
        env_data.hum_value = hum;
        bt_gatt_notify(NULL, &ess_service.attrs[5], &hum, sizeof(hum));
    }
}
```

## src/ble-env.h
```c
#pragma once

/**
 * Update BLE Environmental sensing service temperature
 * @param temp Temperature in 1/100 Celcius
 */
void ble_env_update_temperature(int16_t temp);

/**
 * Update BLE Environmental sensing service humidity
 * @param hum Humidity in 1/100 percent
 */
void ble_env_update_humidity(uint16_t hum);
```

## src/sht21.c
```c
#include <drivers/i2c.h>
#include <logging/log.h>
#include <sys/crc.h>
#include <zephyr.h>

#define SHT21_ADDR 0x40
#define SHT21_SOFT_RESET 0xfe
#define SHT21_TEMP_NO_HOLD 0xf3
#define SHT21_HUM_NO_HOLD 0xf5

LOG_MODULE_REGISTER(SHT21, LOG_LEVEL_DBG);

static const struct device *i2c_dev;

static inline bool check_crc(uint8_t *buf, size_t len)
{
    return (crc8(buf, len - 1, 0x31, 0, false) == buf[len - 1]);
}

void sht21_reset(void)
{
    uint8_t buf = SHT21_SOFT_RESET;
    i2c_write(i2c_dev, &buf, 1, SHT21_ADDR);
    k_sleep(K_MSEC(15));
}

int sht21_temperature(int16_t *temp)
{
    uint8_t cmd = SHT21_TEMP_NO_HOLD;
    uint8_t buf[3];
    int32_t raw = 0;

    memset(buf, 0, sizeof(buf));

    if (i2c_write(i2c_dev, &cmd, sizeof(cmd), SHT21_ADDR))
    {
        LOG_ERR("Failed to start temperature measurement");
        return -EIO;
    }

    k_sleep(K_MSEC(85));

    if (i2c_read(i2c_dev, buf, sizeof(buf), SHT21_ADDR))
    {
        LOG_ERR("Failed to read temperature");
        return -EIO;
    }

    if (!check_crc(buf, sizeof(buf)))
    {
        LOG_ERR("CRC checksum for temperature failed");
        return -EIO;
    }

    raw = ((buf[0] << 8) | buf[1]) & 0xfffc;
    raw *= 17572;
    raw = raw >> 16;
    raw -= 4685;
    *temp = (int16_t) raw;

    return 0;
}

int sht21_humidity(uint16_t *hum)
{
    uint8_t cmd = SHT21_HUM_NO_HOLD;
    uint8_t buf[3];
    int32_t raw = 0;

    memset(buf, 0, sizeof(buf));

    if (i2c_write(i2c_dev, &cmd, sizeof(cmd), SHT21_ADDR))
    {
        LOG_ERR("Failed to start humidity measurement");
        return -EIO;
    }

    k_sleep(K_MSEC(29));

    if (i2c_read(i2c_dev, buf, sizeof(buf), SHT21_ADDR))
    {
        LOG_ERR("Failed to read humidity");
        return -EIO;
    }

    if (!check_crc(buf, sizeof(buf)))
    {
        LOG_ERR("CRC checksum for humidity failed");
        return -EIO;
    }

    raw = ((buf[0] << 8) | buf[1]) & 0xfffc;
    raw *= 12500;
    raw = raw >> 16;
    raw -= 600;
    *hum = (uint16_t) raw;

    return 0;
}

static int sht21_init(const struct device *arg)
{
    ARG_UNUSED(arg);
    i2c_dev = device_get_binding(DT_LABEL(DT_NODELABEL(i2c0)));
    return 0;
}

SYS_INIT(sht21_init, APPLICATION, CONFIG_KERNEL_INIT_PRIORITY_OBJECTS);
```

## src/sht21.h
```c
#pragma once

/**
 * Reset SHT21 chip
 */
void sht21_reset(void);

/**
 * Start temperature measurement and read result
 * @param[out] temp Temperature in 1/100 Celsius
 * @return 0 on success, negative otherwise
 */
int sht21_temperature(int16_t *temp);

/**
 * Start humidity measurement and read result
 * @param[out] hum Humidity in 1/100 percent
 * @return 0 on success, negative otherwise
 */
int sht21_humidity(uint16_t *hum);
```
